#ifndef _OLED_H_
#define _OLED_H_
/*-------------------------------------------------------------------------------------
The MIT License (MIT)

Copyright (c) 2018 奈特

Permission is hereby granted, free of charge, to any person obtaining a copy of
this software and associated documentation files (the "Software"), to deal in
the Software without restriction, including without limitation the rights to
use, copy, modify, merge, publish, distribute, sublicense, and/or sell copies of
the Software, and to permit persons to whom the Software is furnished to do so,
subject to the following conditions:

The above copyright notice and this permission notice shall be included in all
copies or substantial portions of the Software.

THE SOFTWARE IS PROVIDED "AS IS", WITHOUT WARRANTY OF ANY KIND, EXPRESS OR
IMPLIED, INCLUDING BUT NOT LIMITED TO THE WARRANTIES OF MERCHANTABILITY, FITNESS
FOR A PARTICULAR PURPOSE AND NONINFRINGEMENT. IN NO EVENT SHALL THE AUTHORS OR
COPYRIGHT HOLDERS BE LIABLE FOR ANY CLAIM, DAMAGES OR OTHER LIABILITY, WHETHER
IN AN ACTION OF CONTRACT, TORT OR OTHERWISE, ARISING FROM, OUT OF OR IN
CONNECTION WITH THE SOFTWARE OR THE USE OR OTHER DEALINGS IN THE SOFTWARE.

免责说明：
	本软件库以MIT开源协议免费向大众提供。作者只保证原始版本是由作者在维护修BUG，
其他通过网络传播的版本也许被二次修改过，由此出现的BUG与作者无关。而当您使用原始
版本出现BUG时，请联系作者解决。联系方式：进群778916610
------------------------------------------------------------------------------------*/

//-------------------------------以下是图形设置界面，可在Configuration Wizard界面设置----------------------------------------------------------
//<<< Use Configuration Wizard in Context Menu >>>
//<h>基于SSD1306的OLED初始化库
//<i>目前为试做型，仅支持一个设备。
//<h>常用的设置
//<i>这些设置涉及OLED屏幕的规格，请根据实际情况来修改。
//<o>OLED横坐标像素
//<0-128:1>
//<i>本库基于SSD1306，最大支持128。
#define OLED_X_MAX 72
//<o>OLED纵坐标像素
//<16-64:8>
//<i>本库基于SSD1306，最大支持64，该数值必须是8的倍数且大于16（SSD1306要求）。
#define OLED_Y_MAX 40
#define OLED_PAGE_MAX (OLED_Y_MAX/8)
//<o>OLED对比度
//<0-255:1>
//<i>对于单色屏来说也是亮度,可输入0~255。
#define OLED_CONTRAST 250
//<o>OLED的X轴相对于实际屏幕的偏移量
//<0-127:1>
//<i>该设置不会更改硬件配置，只会在软件上加一个偏移。通常只有X轴像素不到128时才使用。
#define OLED_OFFSET_XPIN 28
//<o>OLED的逻辑引脚(Y轴)相对于硬件引脚的偏移量
//<0-63:1>
//<i>移动逻辑引脚时，RAM的内容也会跟着移动,可输入0~63。仅当OLED的纵坐标像素小于64时设置该选项。
#define OLED_OFFSET_LOGIC 0
//<o>OLED的RAM内容相对于逻辑引脚的偏移量
//<0-63:1>
//<i>输入值范围为0~63，但通常不需要改动这个值，因为调节逻辑引脚时，RAM的内容会跟着移动。该值推荐为0。
#define OLED_OFFSET_RAM 0
//<o>OLED的显示模式
//<0-15:1>
//<i>输入值范围为0~15。模式变量由三个参数构成，为了方便打包在一起，通过oled_display_mode_test函数测出当前的oled屏是何种显示模式，然后回来设置。
//<i>测试时屏幕上会显示0~f的代号对应0~15。将正确显示的代号输入该参数即可。比如4号模式下，oled是正常显示的。于是显示模式为4。
#define OLED_DISPLAY_MODE 7
//</h>
//<h>不常用的设置
//<i>这些设置涉及OLED驱动芯片的工作状态，通常不需要更改。
//<o>OLED显示的内容
//<0xa4=>显示RAM <0xa5=>全亮
//<i>只有在第一次点亮时，为了检测oled好坏才会选择“全亮”选项。正常使用请选择“显示RAM”。
#define OLED_DISPLAY_SOURCE 0xA4
//<o>OLED屏内LED像素点的点亮方式
//<0xa6=>数据1亮，数据0灭 <0xa7=>数据0亮，数据1灭
//<i>相当于高电平点亮LED还是低电平点亮LED的问题。
#define OLED_DISPLAY_LED 0xA6
//<o>OLED屏的Vcomh电压
//<0x00=>0.65*VCC <0x10=>0.71*VCC <0x20=>0.77*VCC <0x30=>0.83*VCC <0x40=>0.89*VCC
//<i>该电压是屏内LED的驱动电压，设置得越高，屏幕就越亮。
#define OLED_VCOMH 0x20
//<o.0..3>OLED屏的Phase 1的周期
//<i>LED放电时间，由于电路中存在一定的寄生电容，所以LED两端的电压需要一定时间才能变为0，建议保持默认。
//<o.4..7>OLED屏的Phase 2的周期
//<i>LED充电时间，由于电路中存在一定的寄生电容，所以LED两端的电压需要一定时间才能变为VCC，建议保持默认。
#define OLED_PCC 241
//<o>OLED屏的地址寻址模式
//<0x00=>水平寻址 <0x01=>垂直寻址 <0x02=>页面寻址
//<i>试做版只有页面寻址模式下的写入函数，就保持默认吧。
#define OLED_ADRESS 2
//<o.4..7>OLED的时钟设置
//<i>时钟为参考值，由于制造精度和环境温飘等原因，会有一定的误差。
//<0=>333000Hz  <1=>337625Hz <2=>342250Hz <3=>346875Hz <4=>351500Hz 
//<5=>356125Hz  <6=>360750Hz <7=>365375Hz <8=>370000Hz <9=>374625Hz 
//<10=>379250Hz  <11=>383875Hz <12=>388500Hz <13=>393125Hz <14=>397750Hz 
//<15=>402375Hz  
//<o.0..3>OLED的时钟分频N
//<i>分频系数N，可输入0~15，对应分频1~16分频。
#define OLED_SYSCLK 128
//<q>OLED升压泵开关
//<i>OLED可以额外提供VCC，也可以使用自身的升压泵产生7.5V的电压供给VCC。
#define OLED_DC_DC 1
//</h>
//</h>
//<h>优化设置
//<i>可以把一些代码优化掉节省空间。
//<q>显示模式测试代码
//<i>该函数oled_display_mode_test只是在不明白当前OLED屏工作状态时使用。测试过之后就可以优化掉了。
#define OLED_DISPLAY_MODE_EN 0
//<q>OLED设置信息显示
//<i>该函数oled_information的用处是在调试时，能看到设置的信息。设置好了以后就可以优化掉了。
#define OLED_INFORMATION_EN 0
//<q>oled_printf函数
//<i>当你使用OLED仅仅是用于调试的时候，可以使用oled_printf函数。如果OLED只是UI库的一个组件，可以优化掉所有关于OLED库中显示字符的代码，转而去用UI库的显示代码。
#define OLED_PRINTF_EN 1
//</h>
//<<< end of configuration section >>>
//-------------------------------以上是图形设置界面，可在Configuration Wizard界面设置----------------------------------------------------------
#include "ecbm.h"
#define oled_cmd 0x00
#define oled_dat 0x40

void (* oled_write)(u8 cd,u8 buf);
void oled_on(){//打开oled电源
	oled_write(oled_cmd,0xaf);
}
void oled_off(){//关闭oled电源
	oled_write(oled_cmd,0xae);
}
void oled_set_com(u8 num){//设置OLED使用的COM口数量
	oled_write(oled_cmd,0xa8);
	oled_write(oled_cmd,num);
}
void oled_set_contrast(u8 val){//设置对比度，对于单色屏来说就是亮度。
	oled_write(oled_cmd,0x81);
	oled_write(oled_cmd,val); 
}
void oled_set_pos(u8 x,u8 y){
	oled_write(oled_cmd,0xb0+y);
	oled_write(oled_cmd,((x&0xf0)>>4)|0x10);
	oled_write(oled_cmd,x&0x0f);
}
void oled_set_offset_logic(u8 offset){//设置逻辑引脚相对于硬件引脚的偏移
	oled_write(oled_cmd,0xd3);
	oled_write(oled_cmd,offset);
}
void oled_set_offset_ram(u8 offset){//设置RAM相对逻辑引脚的偏移
	oled_write(oled_cmd,0x40|offset);
}
void oled_fill(u8 dat){
	unsigned char y,x;
	for(y=0;y<OLED_PAGE_MAX;y++)
	{
		oled_write(oled_cmd,0xb0+y);
		oled_write(oled_cmd,0x00);
		oled_write(oled_cmd,0x10);
		for(x=0;x<OLED_X_MAX;x++)
		oled_write(oled_dat,dat);
	}
}
void oled_set_display_mode(u8 mode){
	if(mode&0x01){
		oled_write(oled_cmd,0xa0);//--Set SEG/Column Mapping     0xa0左右反置 0xa1正常
	
	}else{
		oled_write(oled_cmd,0xa1);//--Set SEG/Column Mapping     0xa0左右反置 0xa1正常
	}
	if(mode&0x02){
		oled_write(oled_cmd,0xc0);//Set COM/Row Scan Direction   0xc0上下反置 0xc8正常	
	}else{
		oled_write(oled_cmd,0xc8);//Set COM/Row Scan Direction   0xc0上下反置 0xc8正常	
	}
	oled_write(oled_cmd,0xda);//--set com pins hardware configuration
	oled_write(oled_cmd,0x02|((mode&0x0C)<<2));
}
void oled_set_display(u8 cmd){
	oled_write(oled_cmd,cmd);
}
void oled_set_vcomh(u8 v){
	oled_write(oled_cmd,0xdb);//--set vcomh
	oled_write(oled_cmd,v);//Set VCOM Deselect Level
}
void oled_set_dcdc(u8 en){
	oled_write(oled_cmd,0x8d);//--set Charge Pump enable/disable
	oled_write(oled_cmd,0x10|(en<<2));//--set(0x10) disable
}
void oled_set_pcc(u8 clk){
	oled_write(oled_cmd,0xd9);//--set pre-charge period
	oled_write(oled_cmd,clk);//Set Pre-Charge as 15 Clocks & Discharge as 1 Clock
}
void oled_set_adress_mode(u8 mode){
	oled_write(oled_cmd,0x20);//-Set Page Addressing Mode (0x00/0x01/0x02)
	oled_write(oled_cmd,mode);//
}
void oled_set_clk(u8 clk){
	oled_write(oled_cmd,0xd5);
	oled_write(oled_cmd,clk);
}
void oled_init(void (* fun)(u8,u8)){  
	oled_write=fun;
	oled_off();
	oled_set_com(OLED_Y_MAX-1);
	oled_set_contrast(OLED_CONTRAST);
	oled_set_offset_logic(OLED_OFFSET_LOGIC);
	oled_set_offset_ram(OLED_OFFSET_RAM);
	oled_set_display_mode(OLED_DISPLAY_MODE);
	oled_set_display(OLED_DISPLAY_SOURCE);
	oled_set_display(OLED_DISPLAY_LED);
	oled_set_clk(OLED_SYSCLK);
	oled_set_pcc(OLED_PCC);//--set pre-charge period//Set Pre-Charge as 15 Clocks & Discharge as 1 Clock
	oled_set_vcomh(OLED_VCOMH);
	oled_set_adress_mode(OLED_ADRESS);
	oled_set_dcdc(OLED_DC_DC);
	oled_fill(0);  //初始清屏
	oled_on();
	oled_set_pos(0,0); 	
} 
#if OLED_DISPLAY_MODE_EN
u8 code oled_display_mode_test_buf[]={
0x00,0x3E,0x41,0x41,0x41,0x3E,0x00,0x00,/*"0"*/0xFF,0xFE,0xFC,0xF8,0xF0,0xE0,0xC0,0x80,
0x00,0x00,0x02,0x7F,0x00,0x00,0x00,0x00,/*"1"*/0xFF,0xFE,0xFC,0xF8,0xF0,0xE0,0xC0,0x80,
0x00,0x62,0x51,0x49,0x46,0x00,0x00,0x00,/*"2"*/0xFF,0xFE,0xFC,0xF8,0xF0,0xE0,0xC0,0x80,
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0x00,0x00,0x7F,0x09,0x09,0x00,0x00,0x00,/*"F"*/0xFF,0xFE,0xFC,0xF8,0xF0,0xE0,0xC0,0x80,
/* (8 X 8 , Segoe UI Symbol )*/
};
void oled_display_mode_test(u8 mode){
	u8 x=0,y=0;
	oled_set_display_mode(mode);
	for(y=0;y<8;y++){        //在测试阶段，直接写满8个page
		oled_set_pos(x,y);
		for(x=0;x<128;x++){  //在测试阶段，直接写满128像素
			oled_write(oled_dat,oled_display_mode_test_buf[x%16+mode*16]);
		}
	}
}
#endif
#if OLED_PRINTF_EN
unsigned char code F6x8[] =		
{
0x00, 0x00, 0x00, 0x00, 0x00, 0x00,// sp
0x00, 0x00, 0x00, 0x2f, 0x00, 0x00,// !
0x00, 0x00, 0x07, 0x00, 0x07, 0x00,// "
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0x14, 0x14, 0x14, 0x14, 0x14, 0x14,// horiz lines
};
void oled_char(u8 x,u8 y,char ch){
	u8 i,c;
	c=ch-' ';
	oled_set_pos(x,y);
	for(i=0;i<6;i++){
		oled_write(oled_dat,F6x8[c*6+i]);
	}
}
#include "stdio.h"
void oled_printf(u8 x,u8 y,char * str,...){
	char xdata buf[64];
	u8 len,i,x0,y0;
	va_list vp;
    va_start(vp, str);
    len=vsprintf(buf,str,vp);
    va_end(vp);
	x0=x;
	y0=y;
	for(i=0;i<len;i++){
		
		if(buf[i]=='\r'){
			x0=0;
			continue;
		}
		if(buf[i]=='\n'){
			y0++;
			continue;
		}
		
		if(x0>(OLED_X_MAX-6)){
			x0=0;
			y0++;
		}
		if(y0>=OLED_PAGE_MAX){
			break;
		}
		oled_char(x0,y0,buf[i]);
		x0+=6;
	}
}
#endif
#if OLED_INFORMATION_EN 
void oled_information(){
	oled_printf(16,0,"OLED Information");
	oled_printf(0,2,"Pixel   :%d X %d",(u16)OLED_X_MAX,(u16)OLED_Y_MAX);
	oled_printf(0,3,"Contrast:%d",(u16)OLED_CONTRAST);
	oled_printf(0,4,"Offset  :%d(%d)",(u16)OLED_OFFSET_LOGIC,(u16)OLED_OFFSET_RAM);
	oled_printf(0,5,"Mode    :%d",(u16)OLED_DISPLAY_MODE);
	if(OLED_DC_DC)
		oled_printf(0,6,"Vcomh   :%0.2fV",(0.65f+(float)(OLED_VCOMH>>4)*0.06f)*7.5);
	else 
		oled_printf(0,6,"Vcomh   :%0.2f*VCC",(0.65f+(float)(OLED_VCOMH>>4)*0.06f));
	oled_printf(0,7,"Rate    :%ld FPS",((u32)((OLED_SYSCLK&0xf0)>>4)*4625+333000)/((OLED_SYSCLK&0x0f)+1)/(OLED_Y_MAX)/(50+(OLED_PCC&0xf0>>4)+(OLED_PCC&0x0f)));
}
#endif
#endif
