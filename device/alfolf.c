#include "alfolf.h"
/*--------------------------------------程序定义-----------------------------------*/
/*-------------------------------------------------------
限幅一阶线性滤波器的初始化函数。
-------------------------------------------------------*/
void alfolf_init(alfolf_def * dev,float min,float max){
	dev->min=min;//初始化限幅最小值。
	dev->max=max;//初始化限幅最大值。
	dev->value=0;//初始化初始值。
	dev->err=0;//初始化累计误差。
}
/*-------------------------------------------------------
限幅一阶线性滤波器的数据输入函数。
-------------------------------------------------------*/
void alfolf_in(alfolf_def * dev,float in){
	float a=0.0f,dec=0.0f;
	//通过判断旧值和新值的大小，计算出其差值的绝对值。
	if(dev->value>in){
		dec=dev->value-in;
	}else{
		dec=in-dev->value;
	}
	//-------------------------------------------
	if(dec<dev->min){//当差值的绝对值小于限幅最小值的时候，
		dev->err=dev->err+in-dev->value;//计算差值的累计误差。
		if((dev->err>dev->min)||(dev->err<(-dev->min))){//当累计误差超过限幅最小值时，
			a=dec/dev->max;//求出系数a。
			if(a>1.0f)a=1.0f;//限制a在1以内。
			dev->value=dev->value*(1-a)+in*a;//计算出滤波后的值。
			dev->err=in-dev->value;//重新计算累计误差。
		}
	}else{//当差值的绝对值大于等于限幅最小值的时候，
		a=dec/dev->max;//求出系数a。
		if(a>1.0f)a=1.0f;//限制a在1以内。
		dev->value=dev->value*(1-a)+in*a;//计算出滤波后的值。
		dev->err=0;//累计误差只针对限幅最小值，所以这里清零。
	}
}
